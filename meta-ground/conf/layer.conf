## meta-ground/conf/layer.conf
```bitbake
# We have a conf and classes directory, add to BBPATH
BBPATH .= ":${LAYERDIR}"

# We have recipes-* directories, add to BBFILES
BBFILES += "${LAYERDIR}/recipes-*/*/*.bb \
            ${LAYERDIR}/recipes-*/*/*.bbappend"

BBFILE_COLLECTIONS += "temp"
BBFILE_PATTERN_temp = "^${LAYERDIR}/"
BBFILE_PRIORITY_temp = "6"

LAYERDEPENDS_temp = "core"
LAYERSERIES_COMPAT_temp = "scarthgap"
```
